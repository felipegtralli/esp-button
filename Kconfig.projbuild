## Kconfig.projbuild
```kconfig
menu "ESP Button Configuration"

	config BUTTON_TASK_STACK_SIZE
		int "Button event task stack size"
		default 3072
		range 1024 16384
		help
			Stack size for the button event processing task in bytes.
			Default is 3072.

	config BUTTON_TASK_PRIORITY
		int "Button event task priority"
		default 1
		range 0 20
		help
			Priority of the button event processing task.
			Default is 1 (tskIDLE_PRIORITY + 1).

	config BUTTON_QUEUE_SIZE
		int "Button event queue size"
		default 10
		range 1 50
		help
			Size of the button event queue.
			Default is 10.

endmenu
```

## examples/basic/main/Kconfig.projbuild
```kconfig
menu "Example Configuration"

    config BUTTON_GPIO_NUM
        int "Button GPIO number"
        default 0
        help
            GPIO number where the button is connected.
            Default is 0 (BOOT button on most ESP32 dev boards).
    
endmenu
```
